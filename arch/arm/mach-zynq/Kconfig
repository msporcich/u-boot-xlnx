## arch/arm/mach-zynq/Kconfig
```kconfig
if ARCH_ZYNQ

config ZYNQ_CUSTOM_INIT
	bool "Use custom ps7_init provided by Xilinx tool"
	help
	  U-Boot includes ps7_init_gpl.[ch] for some Zynq board variants.
	  If you want to override them with customized ones
	  or ps7_init code for your board is missing, please say Y here
	  and add ones into board/xilinx/zynq/custom_hw_platform/ directory.

choice
	prompt "Xilinx Zynq board select"
	optional

config TARGET_ZYNQ_ZED
	bool "Zynq ZedBoard"

config TARGET_ZYNQ_MICROZED
	bool "Zynq MicroZed"

config TARGET_ZYNQ_PICOZED
	bool "Zynq PicoZed"

config TARGET_ZYNQ_PICOZED_SDR2
	bool "Zynq PicoZed SDR2"

config TARGET_ZYNQ_ZC70X
	bool "Zynq ZC702/ZC706 Board (deprecated)"
	select ZYNQ_CUSTOM_INIT
	help
	  This option is deprecated.  Use TARGET_ZYNQ_ZC702
	  or TARGET_ZYNQ_706.

config TARGET_ZYNQ_ZC702
	bool "Zynq ZC702 Board"

config TARGET_ZYNQ_ZC706
	bool "Zynq ZC706 Board"

config TARGET_ZYNQ_ZC770
	bool "Zynq ZC770 Board"
	select ZYNQ_CUSTOM_INIT

config TARGET_ZYNQ_ZYBO
	bool "Zynq Zybo Board"
	select ZYNQ_CUSTOM_INIT

config TARGET_ZYNQ_AFX
	bool "Zynq AFX Board"
	select ZYNQ_CUSTOM_INIT

config TARGET_ZYNQ_CSE
	bool "Zynq CSE Board"
	select ZYNQ_CUSTOM_INIT

config TARGET_ZYNQ_CC108
	bool "Zynq CC108 Board"
	select ZYNQ_CUSTOM_INIT

endchoice

config SPL_LDSCRIPT
	default "arch/arm/mach-zynq/u-boot-spl.lds"

config SPL_FS_FAT
	default y

config SPL_LIBCOMMON_SUPPORT
	default y

config SPL_LIBDISK_SUPPORT
	default y

config SPL_LIBGENERIC_SUPPORT
	default y

config SPL_MMC_SUPPORT
	default y if MMC_SDHCI_ZYNQ

config SPL_SERIAL_SUPPORT
	default y

config SPL_SPI_FLASH_SUPPORT
	default y if ZYNQ_QSPI

config SPL_SPI_SUPPORT
	default y if ZYNQ_QSPI

config ZYNQ_DDRC_INIT
	bool "Zynq DDRC initialization"
	default y
	help
	  This option used to perform DDR specific initialization
	  if required. There might be cases like ddr less where we
	  want to skip ddr init and this option is useful for it.

config SYS_BOARD
	string "Board name"
	default "zynq"

config SYS_VENDOR
	string "Vendor name"
	default "xilinx"

config SYS_SOC
	default "zynq"

config SYS_CONFIG_NAME
	default "zynq_zed" if TARGET_ZYNQ_ZED
	default "zynq_microzed" if TARGET_ZYNQ_MICROZED
	default "zynq_picozed" if TARGET_ZYNQ_PICOZED
	default "zynq_zc70x" if TARGET_ZYNQ_ZC702 || TARGET_ZYNQ_ZC706 \
			        || TARGET_ZYNQ_ZC70X
	default "zynq_zc770" if TARGET_ZYNQ_ZC770
	default "zynq_zybo" if TARGET_ZYNQ_ZYBO
	default "zynq_cse" if TARGET_ZYNQ_CSE
	default "zynq_afx" if TARGET_ZYNQ_AFX
	default "zynq_cc108" if TARGET_ZYNQ_CC108
	default "zynq_picozed_sdr2" if TARGET_ZYNQ_PICOZED_SDR2
	string "Board configuration name"
	default "zynq-common"
	help
	  This option contains information about board configuration name.
	  Based on this option include/configs/<CONFIG_SYS_CONFIG_NAME>.h header
	  will be used for board configuration.

config SYS_MALLOC_F_LEN
	default 0x800

config SYS_MALLOC_LEN
	default 0x1400000

config BOOT_INIT_FILE
	string "boot.bin init register filename"
	default ""
	help
	  Add register writes to boot.bin format (max 256 pairs).
	  Expect a table of register-value pairs, e.g. "0x12345678 0x4321"

config ZYNQ_M29EW_WB_HACK
	bool "Zynq NOR hack"
	default n
	help
	  The option provides hack for Zynq NOR driver which is required
	  for NOR operations to work as expected.

config ZYNQ_SDHCI_MAX_FREQ
	default 52000000

endif
```
